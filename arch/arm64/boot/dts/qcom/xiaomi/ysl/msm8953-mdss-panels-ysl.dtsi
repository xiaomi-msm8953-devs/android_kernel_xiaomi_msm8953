/* Copyright (c) 2015-2018, The Linux Foundation. All rights reserved.
 * Copyright (C) 2019 XiaoMi, Inc.
 *
 * This program is free software; you can redistribute it and/or modify
 * it under the terms of the GNU General Public License version 2 and
 * only version 2 as published by the Free Software Foundation.
 *
 * This program is distributed in the hope that it will be useful,
 * but WITHOUT ANY WARRANTY; without even the implied warranty of
 * MERCHANTABILITY or FITNESS FOR A PARTICULAR PURPOSE.  See the
 * GNU General Public License for more details.
 */

#include "panels/dsi-panel-truly-hd720-video.dtsi"
#include "panels/dsi-panel-auo-hd720-video.dtsi"
#include "panels/dsi-panel-shenchao-ili9881c-hd720-video.dtsi"

&dsi_truly_hd720_vid {
	qcom,mdss-dsi-panel-timings-phy-v2 = [1e 1c 04 06 02 03 04 a0
		1e 1c 04 06 02 03 04 a0
		1e 1c 04 06 02 03 04 a0
		1e 1c 04 06 02 03 04 a0
		1e 0f 04 05 02 03 04 a0];
};

&dsi_auo_hd720_vid {
	qcom,mdss-dsi-panel-timings-phy-v2 = [20 1c 06 07 03 03 04 a0
		20 1c 06 07 03 03 04 a0
		20 1c 06 07 03 03 04 a0
		20 1c 06 07 03 03 04 a0
		20 13 05 06 03 03 04 a0];
};

&dsi_sc_ili9881c_hd720_video {
	qcom,mdss-dsi-panel-timings-phy-v2 = [1f 1c 05 07 03 03 04 a0
		1f 1c 05 07 03 03 04 a0
		1f 1c 05 07 03 03 04 a0
		1f 1c 05 07 03 03 04 a0
		1f 11 05 06 03 03 04 a0];
};
