#include "msm-pm8953-ysl.dtsi"
#include "msm-pmi8940-ysl.dtsi"
#include "msm8953-audio-ysl.dtsi"
#include "msm8953-camera-sensor-mtp-ysl.dtsi"
#include "msm8953-mdss-panels-ysl.dtsi"
#include "msm8953-mtp-ysl.dtsi"
#include "msm8953-pinctrl-ysl.dtsi"
#include "msm8953-pm-ysl.dtsi"
#include "msm8953-regulator-ysl.dtsi"
#include "msm8953-ysl.dtsi"
