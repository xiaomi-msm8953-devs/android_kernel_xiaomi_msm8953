## drivers/input/fingerprint/fpc_e6/Kconfig
```kconfig
config FINGERPRINT_FPC1020_E6
	tristate "FingerPrint Cards fingerprint driver support"
	depends on INPUT_FINGERPRINT
	help
	  Say Y here to enable fpc fingerprint driver support!
```

## drivers/input/touchscreen/ft5435_mi/Kconfig
```kconfig
config TOUCHSCREEN_FT5435_MI
       tristate "FocalTech touchscreens"
       depends on I2C
       help
         Say Y here if you have a ft5435 touchscreen.
         Ft5435 controllers are multi touch controllers which can
         report 5 touches at a time.

         If unsure, say N.

         To compile this driver as a module, choose M here: the
         module will be called ft5435_ts.
```

## drivers/input/touchscreen/ft5446_e6/Kconfig
```kconfig
#
# Focaltech Touchscreen driver configuration
#

config TOUCHSCREEN_FT5446_E6
        bool "Focaltech Touchscreen"
		depends on I2C
		default n
		help
		  Say Y here if you have Focaltech touch panel.
		  If unsure, say N.

config TOUCHSCREEN_FTS_DIRECTORY
    string "Focaltech ts directory name"
    default "ft5446_e6"
    depends on TOUCHSCREEN_FT5446_E6
```

## drivers/input/touchscreen/ft8716_d2/Kconfig
```kconfig
#
# Focaltech Touchscreen driver configuration
#

config TOUCHSCREEN_FT8716_D2
	bool "Focaltech Touchscreen"
	depends on I2C
	default n
	help
	  Say Y here if you have Focaltech touch panel.
	  If unsure, say N.
```

## drivers/input/touchscreen/td4310_e7/Kconfig
```kconfig
#
# Synaptics DSX touchscreen driver configuration
#

config TOUCHSCREEN_TD4310_E7
	tristate "synaptics touchscreens"
	depends on I2C
	help
	  Say Y here if you have a Synaptics DSX touchscreen connected
	  to your system.

	  If unsure, say N.

	  To compile this driver as a module, choose M here: the
	  module will be called synaptics_dsx_core.
```

## drivers/input/touchscreen/vituralsar_e7/Kconfig
```kconfig
config TOUCHSCREEN_VITURALSAR_E7
	bool "Vitural Sar series"
	depends on I2C
	help
	  Say Y here if you have a Vituralsar touchscreen.
	  Vituralsar controllers are multi touch controllers which can
	  report 5 touches at a time.

          If unsure, say N.
```

## drivers/platform/xiaomi/Kconfig
```kconfig
# Xiaomi configuration options

config MACH_XIAOMI
	bool "Xiaomi device"
	depends on ARCH_QCOM
	help
	  Support for Xiaomi products

config MACH_XIAOMI_MSM8953
	bool "Xiaomi MSM8953"
	depends on ARCH_QCOM
	select MACH_XIAOMI
	help
	  Support for Xiaomi MSM8953 devices

menu "Xiaomi board selection"

	config MACH_XIAOMI_DAISY
		bool "Xiaomi daisy board"
		select MACH_XIAOMI_MSM8953
		help
		  Support for Mi A2 Lite

	config MACH_XIAOMI_MIDO
		bool "Xiaomi mido board"
		select MACH_XIAOMI_MSM8953
		help
		  Support for Redmi Note 4(x)

	config MACH_XIAOMI_SAKURA
		bool "Xiaomi sakura board"
		select MACH_XIAOMI_MSM8953
		help
		  Support for Redmi 6 Pro

	config MACH_XIAOMI_TISSOT
		bool "Xiaomi tissot board"
		select MACH_XIAOMI_MSM8953
		help
		  Support for Mi A1

	config MACH_XIAOMI_VINCE
		bool "Xiaomi vince board"
		select MACH_XIAOMI_MSM8953
		help
		  Support for Redmi 5 plus / Redmi note 5

	config MACH_XIAOMI_YSL
		bool "Xiaomi ysl board"
		select MACH_XIAOMI_MSM8953
		help
		  Support for Redmi S2 / Y2

endmenu
```
